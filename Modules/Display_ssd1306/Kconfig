## Modules/Display_ssd1306/Kconfig
```kconfig
if I2C

config SSD_1306
	bool "Control LCD display"
	depends on I2C && SYSFS 
        tristate "Module for work with LCD screen based on ssd1306 chip"

        ---help---
        This is module for control lcd display, based on ssd1306 chip by frame buffer 
   
 
  
```

## Modules/mcp6050_Sensor/Kconfig
```kconfig
if I2C

config MCP_6050
	bool "Control sensor on mcp 6050"
	depends on I2C && SYSFS 
        tristate "Module for work with sensor mcp 6050"

        ---help---
        This is module for control sencor based on mcp 6050. Data what can be read:
        - temperature;
        - anlge of position (gyroscop);
        - speed of position change (accelerometer);
        Data can be read by sysfs files: Get_temperature, Get_gyro, Get_accel, Get_interrupt_count
   
 
  
```

## SmartLockControl/External_GPIO_module/Kconfig
```kconfig
config external GPIO
	bool "Control Pins for Smart Lock"
	depends on SMART_LOCK
        tristate "Module for work with external GPIO "

        ---help---
        This is module for control state of pins which use at Smart Lock project 
   
 
```

## SmartLockControl/SmartLock/Kconfig
```kconfig
config Smart_Lock
	bool "Lounch Smart lock system"
	depends SYSFS 
        tristate "Module which contain main logic of program"

        ---help---
        This module contain main logic for  Smart Lock project
   
 
  
```

## SmartLockControl/mfrc522_driver/Kconfig
```kconfig
if SPI

config RFID_cotroller
	bool "Control RFID module"
	depends on SPI && SMART_LOCK 
        tristate "Module for work with RFID module"

        ---help---
        This is module for control RFID module MFRC522 
   
 
  
```
